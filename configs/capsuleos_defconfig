## configs/capsuleos_defconfig
```kconfig
BR2_x86_64=y
BR2_LINUX_KERNEL=y
BR2_LINUX_KERNEL_DEFCONFIG="x86_64"
BR2_TARGET_ROOTFS_ISO9660=y
BR2_TARGET_GRUB2=y
BR2_PACKAGE_BUSYBOX=y
BR2_TARGET_ROOTFS_CPIO_GZIP=y
```
